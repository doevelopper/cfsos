## br2-cfsos/Config.in
```kconfig
# config BR2_CFSOS_DEVEL_BUILD
# 	bool
# 	option env="BR2_CFSOS_DEVEL_BUILD"
# 	help
# 		Developers at Laird can access the closed source repositories,
# 		so they should set this flag to directly build from the closed
# 		source repositories under $BR2_EXTERNAL_CFSOS_CLOSED_SOURCE_PATH/package.

# config BR2_SUMMIT_SECURE_BOOT
# 	bool "Summit Secure Boot"
# 	select BR2_TARGET_UBOOT_NEEDS_OPENSSL
# 	help
# 		This enables "traditional" (down to kernel) secure boot
# 		rootfs security provided by BR2_PACKAGE_CFSOS_ENCRYPTED_STORAGE_TOOLKIT


menu "RT Executive packages: BSP, Drivers and applications."

    menu "Packages (Upstream)"
        source "$BR2_EXTERNAL_CFSOS_PATH/package/cfsos-br/Config.in"
        source "$BR2_EXTERNAL_CFSOS_PATH/package/cfsos-br/Config.in.host"
    endmenu

    menu "Template packages"
        comment "Template Cmake,Makefile and autotools packages"
        source "$BR2_EXTERNAL_CFSOS_PATH/package/template/hello-autotools/Config.in"
        source "$BR2_EXTERNAL_CFSOS_PATH/package/template/hello-cmake/Config.in"
        source "$BR2_EXTERNAL_CFSOS_PATH/package/template/hello-makefile/Config.in"
        source "$BR2_EXTERNAL_CFSOS_PATH/package/drivers/example-module-overlay/Config.in"
    endmenu

    menu "3rd Party"

        menu "Monitoring tools"
            source "$BR2_EXTERNAL_CFSOS_PATH/package/utils/atop2/Config.in"
            source "$BR2_EXTERNAL_CFSOS_PATH/package/utils/btop/Config.in"
            source "$BR2_EXTERNAL_CFSOS_PATH/package/utils/netatop/Config.in"
        endmenu

        menu "Network"

        endmenu

        menu "Benchmarking"

        endmenu

    endmenu

    menu "Linux drivers"
        if BR2_LINUX_KERNEL

            menu "Kernel Space Linux Drivers"
                source "$BR2_EXTERNAL_CFSOS_PATH/package/drivers/kernel-space/foobar_module/Config.in"
                source "$BR2_EXTERNAL_CFSOS_PATH/package/drivers/kernel-space/foobar_chrdev/Config.in"
            endmenu

            menu "Users Space Linux Drivers"
            endmenu
        endif
    endmenu

    menu "Peripheral driver"
        menu "Small TFT Screen"
            # source "$BR2_EXTERNAL_CFSOS_PATH/package/rpi-fbcp/Config.in"
        endmenu
        menu "Pi Hats"
            # source "$BR2_EXTERNAL_CFSOS_PATH/package/recalbox-wpaf/Config.in"
        endmenu
    endmenu

    menu "Applications"

        menu "CFSOS Applications"
            source "$BR2_EXTERNAL_CFSOS_PATH/package/applications/lan-gateway/Config.in"
            source "$BR2_EXTERNAL_CFSOS_PATH/package/applications/rpi-eeprom/Config.in"
        endmenu

        menu "CFSOS Applications Tests "

            menu "CFSOS Unit Testing"

            endmenu

            menu "Regression Unit Testing"

            endmenu

            menu "CFSOS ATP"
                menu "Ruby Runtime Environment"

                endmenu
            endmenu
        endmenu

    endmenu

endmenu
```

## br2-cfsos/configs/qemu_aarch64_virt_defconfig
```kconfig
BR2_aarch64=y
BR2_TOOLCHAIN_EXTERNAL=y
BR2_KERNEL_MIRROR="https://ftp.jaist.ac.jp/pub/Linux/kernel.org"
BR2_GNU_MIRROR="https://ftp.jaist.ac.jp/pub/GNU"
BR2_CPAN_MIRROR="https://ftp.jaist.ac.jp/pub/CPAN"
BR2_TARGET_GENERIC_PASSWD_SHA512=y
BR2_INIT_SYSTEMD=y
BR2_ROOTFS_DEVICE_TABLE_SUPPORTS_EXTENDED_ATTRIBUTES=y
BR2_TARGET_GENERIC_GETTY_PORT="ttyAMA0"
BR2_SYSTEM_DHCP="eth0"
BR2_SYSTEM_DEFAULT_PATH="/bin:/sbin:/usr/bin:/usr/sbin"
BR2_ROOTFS_POST_IMAGE_SCRIPT="$(BR2_EXTERNAL_CFSOS_PATH)/board/qemu_aarch64_virt/post-image.sh support/scripts/genimage.sh"
BR2_ROOTFS_POST_SCRIPT_ARGS="-c $(BR2_EXTERNAL_CFSOS_PATH)/board/qemu_aarch64_virt/genimage.cfg"
BR2_LINUX_KERNEL=y
BR2_LINUX_KERNEL_CUSTOM_VERSION=y
BR2_LINUX_KERNEL_CUSTOM_VERSION_VALUE="5.10.64"
BR2_LINUX_KERNEL_USE_CUSTOM_CONFIG=y
BR2_LINUX_KERNEL_CUSTOM_CONFIG_FILE="$(BR2_EXTERNAL_CFSOS_PATH)/board/qemu_aarch64_virt/linux.config"
BR2_LINUX_KERNEL_ZSTD=y
BR2_LINUX_KERNEL_NEEDS_HOST_OPENSSL=y
BR2_TARGET_ROOTFS_EXT2=y
BR2_TARGET_ROOTFS_EXT2_4=y
BR2_TARGET_ROOTFS_EXT2_SIZE="64M"
BR2_TARGET_ROOTFS_EXT2_RESBLKS=0
# BR2_TARGET_ROOTFS_TAR is not set
BR2_TARGET_EDK2=y
BR2_TARGET_GRUB2=y
BR2_PACKAGE_HOST_DOSFSTOOLS=y
BR2_PACKAGE_HOST_GENIMAGE=y
BR2_PACKAGE_HOST_MTOOLS=y
BR2_PACKAGE_HOST_QEMU=y
BR2_PACKAGE_HOST_QEMU_SYSTEM_MODE=y
BR2_PACKAGE_HOST_QEMU_VIRTFS=y
```

## br2-cfsos/configs/raspberrypi3_64_optee_defconfig
```kconfig
BR2_aarch64=y
BR2_ARM_FPU_VFPV4=y
BR2_TOOLCHAIN_EXTERNAL=y
BR2_TOOLCHAIN_EXTERNAL_GDB_SERVER_COPY=y
BR2_GLOBAL_PATCH_DIR="$(BR2_EXTERNAL_CFSOS_PATH)/board/raspberrypi3_64_optee/patches"
BR2_ROOTFS_DEVICE_CREATION_DYNAMIC_EUDEV=y
BR2_ROOTFS_DEVICE_TABLE="$(BR2_EXTERNAL_CFSOS_PATH)/board/raspberrypi3_64_optee/device_table.txt"
BR2_TARGET_GENERIC_ROOT_PASSWD="root"
BR2_SYSTEM_DHCP="eth0"
BR2_ROOTFS_OVERLAY="$(BR2_EXTERNAL_CFSOS_PATH)/board/raspberrypi3_64_optee/rootfs-overlay"
BR2_ROOTFS_POST_BUILD_SCRIPT="$(BR2_EXTERNAL_CFSOS_PATH)/board/raspberrypi3_64_optee/post-build.sh"
BR2_ROOTFS_POST_IMAGE_SCRIPT="$(BR2_EXTERNAL_CFSOS_PATH)/board/raspberrypi3_64_optee/post-image.sh"
BR2_ROOTFS_POST_SCRIPT_ARGS="--aarch64 --add-miniuart-bt-overlay"
BR2_LINUX_KERNEL=y
BR2_LINUX_KERNEL_CUSTOM_TARBALL=y
BR2_LINUX_KERNEL_CUSTOM_TARBALL_LOCATION="$(call github,raspberrypi,linux,967d45b29ca2902f031b867809d72e3b3d623e7a)/linux-967d45b29ca2902f031b867809d72e3b3d623e7a.tar.gz"
BR2_LINUX_KERNEL_DEFCONFIG="bcmrpi3"
BR2_LINUX_KERNEL_CONFIG_FRAGMENT_FILES="$(BR2_EXTERNAL_CFSOS_PATH)/board/raspberrypi3_64_optee/configs/linux_defconfig"
BR2_LINUX_KERNEL_DTS_SUPPORT=y
BR2_LINUX_KERNEL_INTREE_DTS_NAME="broadcom/bcm2710-rpi-3-b broadcom/bcm2710-rpi-3-b-plus broadcom/bcm2837-rpi-3-b"
BR2_LINUX_KERNEL_NEEDS_HOST_OPENSSL=y
BR2_PACKAGE_RPI_FIRMWARE=y
BR2_PACKAGE_RPI_FIRMWARE_BOOTCODE_BIN=y
BR2_PACKAGE_RPI_FIRMWARE_VARIANT_PI=y
BR2_PACKAGE_RPI_FIRMWARE_CONFIG_FILE="board/raspberrypi3-64/config_3_64bit.txt"
BR2_PACKAGE_LIBOPENSSL_BIN=y
BR2_PACKAGE_LIBOPENSSL_ENGINES=y
BR2_PACKAGE_OPENSSH=y
BR2_PACKAGE_OPTEE_TEST=y
BR2_TARGET_ROOTFS_EXT2=y
BR2_TARGET_ROOTFS_EXT2_4=y
BR2_TARGET_ROOTFS_EXT2_SIZE="256M"
BR2_TARGET_ROOTFS_TAR_GZIP=y
BR2_TARGET_ARM_TRUSTED_FIRMWARE=y
BR2_TARGET_ARM_TRUSTED_FIRMWARE_CUSTOM_TARBALL=y
BR2_TARGET_ARM_TRUSTED_FIRMWARE_CUSTOM_TARBALL_LOCATION="https://github.com/ARM-software/arm-trusted-firmware/archive/refs/tags/v2.10.tar.gz"
BR2_TARGET_ARM_TRUSTED_FIRMWARE_PLATFORM="rpi3"
BR2_TARGET_ARM_TRUSTED_FIRMWARE_FIP=y
BR2_TARGET_ARM_TRUSTED_FIRMWARE_BL32_OPTEE=y
BR2_TARGET_ARM_TRUSTED_FIRMWARE_UBOOT_AS_BL33=y
BR2_TARGET_ARM_TRUSTED_FIRMWARE_ADDITIONAL_VARIABLES="RPI3_RUNTIME_UART=1 LOG_LEVEL=40"
BR2_TARGET_ARM_TRUSTED_FIRMWARE_DEBUG=y
BR2_TARGET_OPTEE_OS=y
BR2_TARGET_OPTEE_OS_CUSTOM_TARBALL=y
BR2_TARGET_OPTEE_OS_CUSTOM_TARBALL_LOCATION="https://github.com/OP-TEE/optee_os/archive/refs/tags/4.1.0.tar.gz"
BR2_TARGET_OPTEE_OS_NEEDS_PYTHON_CRYPTOGRAPHY=y
BR2_TARGET_OPTEE_OS_PLATFORM="rpi3"
BR2_TARGET_OPTEE_OS_ADDITIONAL_VARIABLES="CFG_DT=y DEBUG=1 CFG_TEE_CORE_LOG_LEVEL=2"
BR2_TARGET_UBOOT=y
BR2_TARGET_UBOOT_BUILD_SYSTEM_KCONFIG=y
BR2_TARGET_UBOOT_CUSTOM_VERSION=y
BR2_TARGET_UBOOT_CUSTOM_VERSION_VALUE="2021.07"
BR2_TARGET_UBOOT_BOARD_DEFCONFIG="rpi_3"
BR2_TARGET_UBOOT_CONFIG_FRAGMENT_FILES="$(BR2_EXTERNAL_CFSOS_PATH)/board/raspberrypi3_64_optee/configs/uboot_defconfig"
BR2_TARGET_UBOOT_CUSTOM_MAKEOPTS="EXT_DTB=${BR2_EXTERNAL_CFSOS_PATH}/board/raspberrypi3_64_optee/u-boot-bcm2837-rpi-3-b.dtb"
BR2_PACKAGE_HOST_DOSFSTOOLS=y
BR2_PACKAGE_HOST_GENIMAGE=y
BR2_PACKAGE_HOST_MTOOLS=y
BR2_PACKAGE_HOST_UBOOT_TOOLS=y
BR2_PACKAGE_HOST_UBOOT_TOOLS_FIT_SUPPORT=y
BR2_PACKAGE_HOST_UBOOT_TOOLS_FIT_SIGNATURE_SUPPORT=y
BR2_PACKAGE_HOST_UBOOT_TOOLS_ENVIMAGE=y
BR2_PACKAGE_HOST_UBOOT_TOOLS_ENVIMAGE_SOURCE="$(BR2_EXTERNAL_CFSOS_PATH)/board/raspberrypi3_64_optee/uboot.env.txt"
BR2_PACKAGE_HOST_UBOOT_TOOLS_ENVIMAGE_SIZE="0x4000"
```

## br2-cfsos/package/application/Config.in
```kconfig
config BR2_PACKAGE_USERSPACE_PROGRAM
	bool "application"
	depends on BR2_LINUX_KERNEL
	help
	  Linux Userspace Application Program Cheat.
```

## br2-cfsos/package/applications/python-mycmath/Config.in
```kconfig
config BR2_PACKAGE_PYTHON_MYCMATH
	bool "mycmath: CPython module"
	depends on BR2_PACKAGE_PYTHON3
```

## br2-cfsos/package/applications/python-mymath/Config.in
```kconfig
config BR2_PACKAGE_PYTHON_MYMATH
	bool "mymath: Pure Python"
	depends on BR2_PACKAGE_PYTHON3
```

## br2-cfsos/package/criterion/Config.in
```kconfig
config BR2_PACKAGE_CRITERION
	bool "criterion"
	select BR2_PACKAGE_LIBFFI
	select BR2_PACKAGE_LIBGLIB2
	help
	  Criterion is a cross-platform C and C++ unit testing
	  framework.

	  https://github.com/Snaipe/Criterion
```

## br2-cfsos/package/kernel-modules/Config.in
```kconfig
menu "KM Incubator"
	source "$BR2_EXTERNAL_CFSOS_PATH/package/kernel-modules/kmod-example/Config.in"
endmenu
```

## br2-cfsos/wip-configs/lfs_latest_defconfig
```kconfig
BR2_aarch64=y
BR2_ARM_FPU_VFPV4=y
BR2_TOOLCHAIN_EXTERNAL=y
BR2_TARGET_GENERIC_PASSWD_SHA512=y
BR2_INIT_SYSTEMD=y
BR2_TARGET_GENERIC_ROOT_PASSWD="root"
BR2_SYSTEM_BIN_SH_BASH=y
BR2_SYSTEM_DHCP="eth0"
BR2_SYSTEM_DEFAULT_PATH="/bin:/sbin:/usr/bin:/usr/sbin"
BR2_ROOTFS_USERS_TABLES="$(BR2_EXTERNAL_CFSOS_PATH)/board/common/users-table.cfg"
BR2_ROOTFS_POST_BUILD_SCRIPT="$(BR2_EXTERNAL_CFSOS_PATH)/board/lfs_latest/scripts/post-build.sh"
BR2_ROOTFS_POST_IMAGE_SCRIPT="$(BR2_EXTERNAL_CFSOS_PATH)/board/lfs_latest/scripts//post-image.sh"
BR2_ROOTFS_POST_SCRIPT_ARGS="--aarch64 --add-miniuart-bt-overlay"
BR2_LINUX_KERNEL=y
BR2_LINUX_KERNEL_CUSTOM_TARBALL=y
BR2_LINUX_KERNEL_CUSTOM_TARBALL_LOCATION="$(call github,raspberrypi,linux,223d1247c0b0c0659a65949b6b9c3de53fd14223)/linux-223d1247c0b0c0659a65949b6b9c3de53fd14223.tar.gz"
BR2_LINUX_KERNEL_DEFCONFIG="bcmrpi3"
BR2_LINUX_KERNEL_DTS_SUPPORT=y
BR2_LINUX_KERNEL_INTREE_DTS_NAME="broadcom/bcm2710-rpi-3-b broadcom/bcm2710-rpi-3-b-plus broadcom/bcm2837-rpi-3-b"
BR2_LINUX_KERNEL_NEEDS_HOST_OPENSSL=y
BR2_PACKAGE_XZ=y
BR2_PACKAGE_RPI_FIRMWARE=y
BR2_PACKAGE_RPI_FIRMWARE_BOOTCODE_BIN=y
BR2_PACKAGE_RPI_FIRMWARE_VARIANT_PI=y
BR2_PACKAGE_RPI_FIRMWARE_CONFIG_FILE="$(BR2_EXTERNAL_CFSOS_PATH)/board/lfs_latest/config_3_64bit.txt"
BR2_PACKAGE_RPI_FIRMWARE_CMDLINE_FILE="$(BR2_EXTERNAL_CFSOS_PATH)/board/lfs_latest/cmdline.txt"
BR2_TARGET_ROOTFS_EXT2=y
BR2_TARGET_ROOTFS_EXT2_4=y
BR2_TARGET_ROOTFS_EXT2_SIZE="256M"
# BR2_TARGET_ROOTFS_TAR is not set
BR2_TARGET_UBOOT=y
BR2_TARGET_UBOOT_BUILD_SYSTEM_KCONFIG=y
BR2_TARGET_UBOOT_CUSTOM_TARBALL=y
BR2_TARGET_UBOOT_CUSTOM_TARBALL_LOCATION="https://github.com/u-boot/u-boot/archive/refs/tags/v2024.01.tar.gz"
BR2_TARGET_UBOOT_BOARD_DEFCONFIG="rpi_3"
BR2_TARGET_UBOOT_CONFIG_FRAGMENT_FILES="$(BR2_EXTERNAL_CFSOS_PATH)/board/lfs_latest/configs/uboot.fragment"
BR2_PACKAGE_HOST_DOSFSTOOLS=y
BR2_PACKAGE_HOST_GENIMAGE=y
BR2_PACKAGE_HOST_KMOD_XZ=y
BR2_PACKAGE_HOST_MTOOLS=y
BR2_PACKAGE_HOST_UBOOT_TOOLS=y
BR2_PACKAGE_HOST_UBOOT_TOOLS_ENVIMAGE=y
BR2_PACKAGE_HOST_UBOOT_TOOLS_ENVIMAGE_SOURCE="$(BR2_EXTERNAL_CFSOS_PATH)/board/lfs_latest/uboot.env.txt"
BR2_PACKAGE_HOST_UBOOT_TOOLS_ENVIMAGE_SIZE="0x4000"
```

## br2-templates/Config.in
```kconfig
menu "Templates Application"

    source "$BR2_EXTERNAL_TEMPLATE_PATH/package/applications/hello-autotools/Config.in"
    source "$BR2_EXTERNAL_TEMPLATE_PATH/package/applications/hello-cmake/Config.in"
    source "$BR2_EXTERNAL_TEMPLATE_PATH/package/applications/hello-makefile/Config.in"

endmenu
```

## br2-templates/configs/raspberrypi3_64_defconfig
```kconfig
BR2_aarch64=y
BR2_TOOLCHAIN_EXTERNAL=y
BR2_TARGET_GENERIC_HOSTNAME="cseos"
BR2_TARGET_GENERIC_ISSUE="Core System Executive"
BR2_INIT_SYSTEMD=y
BR2_TARGET_GENERIC_ROOT_PASSWD="happyman"
BR2_SYSTEM_BIN_SH_BASH=y
BR2_SYSTEM_DEFAULT_PATH="/bin:/sbin:/usr/bin:/usr/sbin"
BR2_ROOTFS_USERS_TABLES="$(BR2_EXTERNAL_TEMPLATE_PATH)/board/common/users_tables.txt"
BR2_ROOTFS_OVERLAY="$(BR2_EXTERNAL_TEMPLATE_PATH)/board/raspberrypi3-64/rootfs-overlay"
BR2_ROOTFS_POST_BUILD_SCRIPT="$(BR2_EXTERNAL_TEMPLATE_PATH)/board/raspberrypi3-64/post-build.sh"
BR2_ROOTFS_POST_IMAGE_SCRIPT="$(BR2_EXTERNAL_TEMPLATE_PATH)/board/raspberrypi3-64/post-image.sh"
BR2_ROOTFS_POST_SCRIPT_ARGS="--aarch64"
BR2_LINUX_KERNEL=y
BR2_LINUX_KERNEL_CUSTOM_TARBALL=y
BR2_LINUX_KERNEL_CUSTOM_TARBALL_LOCATION="$(call github,raspberrypi,linux,74bc238e86e62109c74d8f229dc105bf3818b4a7)/linux-74bc238e86e62109c74d8f229dc105bf3818b4a7.tar.gz"
BR2_LINUX_KERNEL_USE_CUSTOM_CONFIG=y
BR2_LINUX_KERNEL_CUSTOM_CONFIG_FILE="$(BR2_EXTERNAL_TEMPLATE_PATH)/board/raspberrypi3-64/configs/linux.config"
BR2_LINUX_KERNEL_DTS_SUPPORT=y
BR2_LINUX_KERNEL_INTREE_DTS_NAME="broadcom/bcm2710-rpi-3-b broadcom/bcm2710-rpi-3-b-plus broadcom/bcm2837-rpi-3-b"
BR2_PACKAGE_BUSYBOX_CONFIG="$(BR2_EXTERNAL_TEMPLATE_PATH)/board/raspberrypi3-64/configs/busybox.config"
BR2_PACKAGE_RPI_FIRMWARE=y
BR2_PACKAGE_RPI_FIRMWARE_BOOTCODE_BIN=y
BR2_PACKAGE_RPI_FIRMWARE_VARIANT_PI=y
BR2_PACKAGE_RPI_FIRMWARE_CONFIG_FILE="$(BR2_EXTERNAL_TEMPLATE_PATH)/board/raspberrypi3-64/config_3_64bit.txt"
BR2_PACKAGE_RPI_FIRMWARE_CMDLINE_FILE="$(BR2_EXTERNAL_TEMPLATE_PATH)/board/raspberrypi3-64/cmdline.txt"
BR2_PACKAGE_LIBSODIUM=y
BR2_PACKAGE_LIBSSH2=y
BR2_PACKAGE_LIBESMTP=y
BR2_PACKAGE_DHCP=y
BR2_PACKAGE_DHCP_CLIENT=y
BR2_PACKAGE_DHCPCD=y
BR2_PACKAGE_ETHTOOL=y
BR2_PACKAGE_IFTOP=y
BR2_PACKAGE_IFUPDOWN=y
BR2_PACKAGE_NGINX=y
BR2_PACKAGE_NGINX_HTTP_CACHE=y
BR2_PACKAGE_NGINX_HTTP_SSL_MODULE=y
BR2_PACKAGE_NGINX_HTTP_V2_MODULE=y
BR2_PACKAGE_NGINX_HTTP_REALIP_MODULE=y
BR2_PACKAGE_NGINX_HTTP_ADDITION_MODULE=y
BR2_PACKAGE_NGINX_HTTP_XSLT_MODULE=y
BR2_PACKAGE_NGINX_HTTP_IMAGE_FILTER_MODULE=y
BR2_PACKAGE_NGINX_HTTP_GEOIP_MODULE=y
BR2_PACKAGE_NGINX_HTTP_SUB_MODULE=y
BR2_PACKAGE_NGINX_HTTP_GUNZIP_MODULE=y
BR2_PACKAGE_NGINX_HTTP_GZIP_STATIC_MODULE=y
BR2_PACKAGE_NGINX_HTTP_AUTH_REQUEST_MODULE=y
BR2_PACKAGE_NGINX_HTTP_RANDOM_INDEX_MODULE=y
BR2_PACKAGE_NGINX_HTTP_SECURE_LINK_MODULE=y
BR2_PACKAGE_NGINX_HTTP_DEGRADATION_MODULE=y
BR2_PACKAGE_NGINX_HTTP_SLICE_MODULE=y
BR2_PACKAGE_NGINX_HTTP_STUB_STATUS_MODULE=y
BR2_PACKAGE_NGINX_MODSECURITY=y
BR2_PACKAGE_NGINX_UPLOAD=y
BR2_PACKAGE_OPENSSH=y
BR2_PACKAGE_RSYNC=y
BR2_PACKAGE_TFTPD=y
BR2_PACKAGE_HTOP=y
BR2_PACKAGE_RAUC=y
BR2_PACKAGE_RAUC_DBUS=y
BR2_PACKAGE_RAUC_GPT=y
BR2_PACKAGE_RAUC_NETWORK=y
BR2_PACKAGE_RAUC_STREAMING=y
BR2_PACKAGE_RAUC_JSON=y
BR2_PACKAGE_RSYSLOG=y
BR2_PACKAGE_WATCHDOGD=y
BR2_TARGET_ROOTFS_INITRAMFS=y
# BR2_TARGET_ROOTFS_TAR is not set
BR2_TARGET_UBOOT=y
BR2_TARGET_UBOOT_BUILD_SYSTEM_KCONFIG=y
BR2_TARGET_UBOOT_CUSTOM_TARBALL=y
BR2_TARGET_UBOOT_CUSTOM_TARBALL_LOCATION="https://github.com/u-boot/u-boot/archive/refs/tags/v2023.10-rc1.tar.gz"
BR2_TARGET_UBOOT_USE_CUSTOM_CONFIG=y
BR2_TARGET_UBOOT_CUSTOM_CONFIG_FILE="$(BR2_EXTERNAL_TEMPLATE_PATH)/board/raspberrypi3-64/configs/uboot.config"
BR2_TARGET_UBOOT_NEEDS_OPENSSL=y
BR2_TARGET_UBOOT_SPL=y
BR2_TARGET_UBOOT_SPL_NAME="u-boot u-boot.map u-boot-nodtb.bin u-boot.srec"
BR2_PACKAGE_HOST_DOSFSTOOLS=y
BR2_PACKAGE_HOST_E2FSPROGS=y
BR2_PACKAGE_HOST_GENIMAGE=y
BR2_PACKAGE_HOST_MTD=y
BR2_PACKAGE_HOST_MTOOLS=y
BR2_PACKAGE_HOST_RAUC=y
BR2_PACKAGE_HOST_UBOOT_TOOLS=y
```

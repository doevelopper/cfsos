// Device tree overlay for I2C connected BME280 DHT sensor.
/dts-v1/;
/plugin/;

/ {
	compatible = "brcm,bcm2835";

	fragment@0 {
		target = <&i2c1>;
		__overlay__ {
			#address-cells = <1>;
			#size-cells = <0>;
			status = "okay";

			bme280: bme280@76 {
				compatible = "bosch,bme280";
				reg = <0x76>;
			};
		};
	};

	__overrides__ {
		addr = <&bme280>,"reg:0";
	};
};